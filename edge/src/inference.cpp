// TFLite Micro interpreter for the INT8 ConvLSTM-tiny.
//
// The model arrives as a byte array in flash (model.h, generated by
// ml/scripts/tflite_to_header.py); the serving meta (threshold, channel stats)
// rides in model_meta.h from the same generator, keeping train == serve.
#include "inference.h"

#include <Arduino.h>

#include "model.h"
#include "model_meta.h"

#include "tensorflow/lite/micro/micro_interpreter.h"
#include "tensorflow/lite/micro/micro_log.h"
#include "tensorflow/lite/micro/micro_mutable_op_resolver.h"
#include "tensorflow/lite/schema/schema_generated.h"

namespace {

// ~46 KB of INT8 weights + LSTM state + conv activations. 96 KB measured-with-
// headroom; arena_used_bytes() is logged at init so this can be trimmed once
// the first real conversion lands.
constexpr int kArenaSize = 96 * 1024;
alignas(16) uint8_t s_arena[kArenaSize];

// The op list for the ai-edge-torch export of conv1d×3 → LSTM → linear:
// conv1d lowers to CONV_2D(+RESHAPE/TRANSPOSE), BN folds into conv weights,
// the recurrence becomes UNIDIRECTIONAL_SEQUENCE_LSTM, the head FULLY_CONNECTED.
// If AllocateTensors() reports a missing op after the first real conversion,
// add it here (and check quantize.py's LSTM-op risk note).
constexpr int kMaxOps = 12;
tflite::MicroMutableOpResolver<kMaxOps> *s_resolver = nullptr;
const tflite::Model *s_model = nullptr;
tflite::MicroInterpreter *s_interpreter = nullptr;
TfLiteTensor *s_input = nullptr;
TfLiteTensor *s_output = nullptr;
bool s_ready = false;

}  // namespace

namespace inference {

bool init() {
#ifndef FG_MODEL_GENERATED
  log_e("model.h is the placeholder — generate it: python ml/scripts/export_tflite.py "
        "(Linux/Docker). Running heartbeat-only, no fall detection.");
  return false;
#else
  s_model = tflite::GetModel(g_fall_model);
  if (s_model->version() != TFLITE_SCHEMA_VERSION) {
    log_e("model schema v%lu != supported v%d", (unsigned long)s_model->version(),
          TFLITE_SCHEMA_VERSION);
    return false;
  }

  static tflite::MicroMutableOpResolver<kMaxOps> resolver;
  resolver.AddConv2D();
  resolver.AddDepthwiseConv2D();
  resolver.AddUnidirectionalSequenceLSTM();
  resolver.AddFullyConnected();
  resolver.AddReshape();
  resolver.AddTranspose();
  resolver.AddStridedSlice();
  resolver.AddQuantize();
  resolver.AddDequantize();
  resolver.AddLogistic();
  resolver.AddAdd();
  resolver.AddMul();
  s_resolver = &resolver;

  static tflite::MicroInterpreter interpreter(s_model, resolver, s_arena, kArenaSize);
  s_interpreter = &interpreter;
  if (interpreter.AllocateTensors() != kTfLiteOk) {
    log_e("AllocateTensors failed — arena too small or an op is missing from "
          "the resolver (see inference.cpp op list)");
    return false;
  }
  log_i("tensor arena used: %u / %d bytes", interpreter.arena_used_bytes(), kArenaSize);

  s_input = interpreter.input(0);
  s_output = interpreter.output(0);
  if (s_input->dims->size < 2 ||
      s_input->dims->data[s_input->dims->size - 2] != WINDOW_SAMPLES ||
      s_input->dims->data[s_input->dims->size - 1] != N_CHANNELS) {
    log_e("input tensor is not (1, %d, %d)", WINDOW_SAMPLES, N_CHANNELS);
    return false;
  }

  s_ready = true;
  return true;
#endif
}

bool ready() { return s_ready; }

float predict(const float window[WINDOW_SAMPLES * N_CHANNELS]) {
  if (!s_ready) return -1.0f;

  // Standardize with the training-time channel stats, then quantize with the
  // input tensor's own (scale, zero_point) — mirrors validate_tflite.py exactly.
  const float in_scale = s_input->params.scale;
  const int in_zp = s_input->params.zero_point;
  for (int i = 0; i < WINDOW_SAMPLES; i++) {
    for (int c = 0; c < N_CHANNELS; c++) {
      const float std_val =
          (window[i * N_CHANNELS + c] - FG_CHANNEL_MEAN[c]) / FG_CHANNEL_STD[c];
      if (s_input->type == kTfLiteInt8) {
        const int q = (int)lroundf(std_val / in_scale) + in_zp;
        s_input->data.int8[i * N_CHANNELS + c] = (int8_t)constrain(q, -128, 127);
      } else {
        s_input->data.f[i * N_CHANNELS + c] = std_val;
      }
    }
  }

  const uint32_t t0 = micros();
  if (s_interpreter->Invoke() != kTfLiteOk) {
    log_e("Invoke failed");
    return -1.0f;
  }
  log_d("inference: %lu us", (unsigned long)(micros() - t0));

  float logit;
  if (s_output->type == kTfLiteInt8) {
    logit = ((float)s_output->data.int8[0] - s_output->params.zero_point) *
            s_output->params.scale;
  } else {
    logit = s_output->data.f[0];
  }
  return 1.0f / (1.0f + expf(-logit));
}

}  // namespace inference
